## Config.in
```kconfig
menu "k1cam"

source "$BR2_EXTERNAL_K1CAM_PATH/package/ingenic-lib/Config.in"
source "$BR2_EXTERNAL_K1CAM_PATH/package/ingenic-sdk/Config.in"
source "$BR2_EXTERNAL_K1CAM_PATH/package/ingenic-system-libs-neo/Config.in"
source "$BR2_EXTERNAL_K1CAM_PATH/package/ingenic-uclibc/Config.in"
source "$BR2_EXTERNAL_K1CAM_PATH/package/thingino-raptor-hal/Config.in"
source "$BR2_EXTERNAL_K1CAM_PATH/package/thingino-sensor-info/Config.in"
source "$BR2_EXTERNAL_K1CAM_PATH/package/k1cam-uvcd/Config.in"

endmenu
```

## configs/k1cam_defconfig
```kconfig
BR2_mipsel=y
BR2_mips_xburst=y
# BR2_MIPS_SOFT_FLOAT is not set
BR2_MIPS_FP32_MODE_32=y
BR2_TOOLCHAIN_EXTERNAL=y
BR2_TOOLCHAIN_EXTERNAL_DOWNLOAD=y
BR2_TOOLCHAIN_EXTERNAL_URL="https://github.com/themactep/thingino-firmware/releases/download/toolchain-x86_64/thingino-toolchain-x86_64_xburst1_uclibc_gcc16-linux-mipsel.tar.gz"
BR2_TOOLCHAIN_EXTERNAL_HEADERS_3_10=y
BR2_TOOLCHAIN_EXTERNAL_LOCALE=y
BR2_TOOLCHAIN_EXTERNAL_CXX=y
BR2_TARGET_LDFLAGS="-z max-page-size=0x1000"
BR2_CCACHE=y
BR2_STRIP_EXCLUDE_FILES="libimp.so libalog.so libsysutils.so"
BR2_OPTIMIZE_S=y
BR2_PACKAGE_OVERRIDE_FILE="$(BR2_EXTERNAL_THINGINO_PATH)/package/thingino-overrides.mk"
BR2_GLOBAL_PATCH_DIR="$(BR2_EXTERNAL_THINGINO_PATH)/package/all-patches"
BR2_PER_PACKAGE_DIRECTORIES=y
BR2_TARGET_GENERIC_HOSTNAME="k1cam"
BR2_TARGET_GENERIC_ISSUE="k1cam"
BR2_TARGET_GENERIC_PASSWD_SHA512=y
BR2_ROOTFS_MERGED_USR=y
BR2_TARGET_GENERIC_ROOT_PASSWD="root"
# BR2_TARGET_GENERIC_REMOUNT_ROOTFS_RW is not set
BR2_SYSTEM_DEFAULT_PATH="/bin:/sbin:/usr/bin:/usr/sbin"
BR2_ROOTFS_OVERLAY="$(BR2_EXTERNAL_THINGINO_PATH)/overlay"
BR2_ROOTFS_POST_BUILD_SCRIPT="$(BR2_EXTERNAL_THINGINO_PATH)/board/k1cam/post-build.sh $(BR2_EXTERNAL_THINGINO_PATH)/scripts/rootfs_script.sh $(BR2_EXTERNAL_THINGINO_PATH)/board/k1cam/post-build.sh"
BR2_ROOTFS_POST_IMAGE_SCRIPT="$(BR2_EXTERNAL_THINGINO_PATH)/board/k1cam/post-image.sh"
BR2_LINUX_KERNEL_CUSTOM_GIT=y
BR2_LINUX_KERNEL_CUSTOM_REPO_URL="$(BR2_EXTERNAL_THINGINO_PATH)/../thingino-linux"
BR2_LINUX_KERNEL_CUSTOM_REPO_VERSION="4727879284cf8f1314e1fd66740573ef70efd057"
BR2_LINUX_KERNEL_USE_CUSTOM_CONFIG=y
BR2_LINUX_KERNEL_CUSTOM_CONFIG_FILE="$(BR2_EXTERNAL_THINGINO_PATH)/board/ingenic/xburst1/kernel/3.10.14/t31.generic.config"
BR2_LINUX_KERNEL_LZMA=y
BR2_LINUX_KERNEL_EXT_THINGINO_KOPT=y
BR2_PACKAGE_BUSYBOX_CONFIG="$(BR2_EXTERNAL_THINGINO_PATH)/package/busybox/busybox.config"
BR2_PACKAGE_BUSYBOX_CONFIG_FRAGMENT_FILES="$(BR2_EXTERNAL_THINGINO_PATH)/board/k1cam/busybox.fragment"
# BR2_PACKAGE_DROPBEAR is not set
# BR2_PACKAGE_IFUPDOWN_SCRIPTS is not set
BR2_TARGET_ROOTFS_SQUASHFS=y
BR2_TARGET_ROOTFS_SQUASHFS_BS_256K=y
BR2_TARGET_ROOTFS_SQUASHFS4_XZ=y
BR2_TARGET_ROOTFS_SQUASHFS_EXTREME_COMP=y
# BR2_TARGET_ROOTFS_TAR is not set
BR2_TARGET_UBOOT_BOARD_DEFCONFIG="isvp_t31l_sfcnor"
BR2_TARGET_UBOOT_CONFIG_FRAGMENT_FILES="$(BR2_EXTERNAL_THINGINO_PATH)/configs/uboot/layout/sfcnor.config $(BR2_EXTERNAL_THINGINO_PATH)/configs/uboot/variants/t31l.config"
BR2_TARGET_UBOOT_DEFAULT_ENV_FILE="$(BR2_EXTERNAL_THINGINO_PATH)/board/k1cam/uenv.txt"
# BR2_TARGET_UBOOT_FORMAT_BIN is not set
BR2_TARGET_UBOOT_FORMAT_CUSTOM=y
BR2_TARGET_UBOOT_FORMAT_CUSTOM_NAME="u-boot-with-tpl-lzma.bin"
BR2_TARGET_UBOOT_CUSTOM_MAKEOPTS="-j1"
BR2_PACKAGE_HOST_MTD=y
BR2_INGENIC_SOC_MODEL="t31l"
BR2_ISP_CLK_200MHZ=y
BR2_SENSOR_1_NAME="gc2083"
BR2_THINGINO_DEV_WEBCAM=y
# BR2_PACKAGE_THINGINO_KOPT_LEDS is not set
BR2_PACKAGE_THINGINO_KOPT_USB_GADGET_ONLY=y
BR2_PACKAGE_THINGINO_KOPT_DWC2=y
BR2_PACKAGE_THINGINO_KOPT_DWC2_OTG=y
BR2_THINGINO_TOOLCHAIN_LIBC_UCLIBC=y
BR2_PACKAGE_THINGINO_GPIO=y
BR2_PACKAGE_THINGINO_SYSTEM=y
BR2_PACKAGE_K1CAM_UVCD=y
BR2_PACKAGE_THINGINO_UBOOT_EXTERNAL_ENV_ENABLE=y
BR2_PACKAGE_THINGINO_UBOOT_ROOTFSTYPE="squashfs"
BR2_PACKAGE_THINGINO_UBOOT_INIT="/init"
# BR2_THINGINO_PACKAGES is not set
```

## package/ingenic-lib/Config.in
```kconfig
config BR2_PACKAGE_INGENIC_LIB
	bool
	help
	  Ingenic T31 IMP userspace library.
```

## package/ingenic-sdk/Config.in
```kconfig
config BR2_PACKAGE_INGENIC_SDK
	bool "Ingenic T31 camera modules"
	select BR2_LINUX_KERNEL
	help
	  Build the T31 ISP, GC2083 sensor, and AVPU modules used by k1cam.
```

## package/ingenic-system-libs-neo/Config.in
```kconfig
config BR2_PACKAGE_INGENIC_SYSTEM_LIBS_NEO
	bool
	depends on BR2_PACKAGE_INGENIC_LIB
	help
	  Open-source libalog replacement used by k1cam.
```

## package/k1cam-uvcd/Config.in
```kconfig
config BR2_PACKAGE_K1CAM_UVCD
	bool "k1cam-uvcd"
	select BR2_PACKAGE_THINGINO_RAPTOR_HAL
	select BR2_PACKAGE_THINGINO_SENSOR_INFO
	help
	  Minimal fixed-function UVC webcam daemon for T31 + GC2083.

	  Fuses ISP/encoder bring-up and the UVC gadget bridge into one
	  process. Standard image controls are exposed on the UVC
	  Processing Unit; nonstandard ISP controls on Extension Unit 4.

	  Requires the uvcd gadget descriptors in the kernel's
	  g_webcam.
```

## package/thingino-raptor-hal/Config.in
```kconfig
config BR2_PACKAGE_THINGINO_RAPTOR_HAL
	bool
	select BR2_PACKAGE_INGENIC_LIB
	select BR2_PACKAGE_INGENIC_UCLIBC
	select BR2_PACKAGE_INGENIC_SYSTEM_LIBS_NEO
```

## package/thingino-uvcd/Config.in
```kconfig
config BR2_PACKAGE_THINGINO_UVCD
	bool
	select BR2_PACKAGE_THINGINO_RAPTOR_HAL
	select BR2_PACKAGE_THINGINO_KOPT_GADGET_WEBCAM
	select BR2_PACKAGE_THINGINO_SYSTEM_USB_ROLE
```
